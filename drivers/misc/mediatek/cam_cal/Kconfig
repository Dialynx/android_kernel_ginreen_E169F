## drivers/misc/mediatek/cam_cal/Kconfig
```kconfig
##zhenglihong 20150723 begin
config MTK_CAM_CAL
  bool CONFIG_MTK_CAM_CAL
  default n
  help
    CONFIG_MTK_CAM_CAL define if the camera cal driver should be built in or not
##zhenglihong 20150723 begin
```

## drivers/misc/mediatek/irtx/Kconfig
```kconfig
config MTK_IRTX_HW_SUPPORT
	bool "MediaTek consumer IR tansmitter - PWM+IRTX solution"
	default n

config MTK_IRTX_SUPPORT
	bool "MediaTek consumer IR tansmitter - PWM only solution"
	default n
```
